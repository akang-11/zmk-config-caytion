## config/boards/shields/Kconfig.defconfig
```kconfig
if SHIELD_CAYTION_LEFT

config ZMK_KEYBOARD_NAME
    default "Caytion"

config ZMK_SPLIT_ROLE_CENTRAL
    default y

endif

if SHIELD_CAYTION_LEFT || SHIELD_CAYTION_RIGHT

config ZMK_SPLIT
    default y

endif
```

## config/boards/shields/Kconfig.shield
```kconfig
config SHIELD_CAYTION_LEFT
    def_bool $(shields_list_contains,caytion_left)

config SHIELD_CAYTION_RIGHT
    def_bool $(shields_list_contains,caytion_right)
```
